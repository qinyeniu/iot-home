## firmware/diag_wifi_scan/sdkconfig.defaults
```kconfig
CONFIG_IDF_TARGET="esp32c6"
CONFIG_ESPTOOLPY_FLASHSIZE_4MB=y
CONFIG_LOG_DEFAULT_LEVEL_INFO=y
```

## firmware/node_battery_sensor/main/Kconfig
```kconfig
menu "Battery sensor"

config BATT_SAMPLE_INTERVAL_S
    int "Sampling and ZCL report interval (seconds)"
    default 60
    range 5 3600
    help
        How often the SED samples AHT20/BH1750 and sends reports.
        Use 60 seconds for bench validation, then longer intervals for
        battery-life testing.

config BATT_KEEP_ALIVE_MS
    int "Zigbee keep-alive/poll interval (milliseconds)"
    default 60000
    range 5000 600000
    help
        Keep-alive interval advertised to the parent. Aligning it with the
        sample interval avoids extra wakeups during bench testing.

config BATT_STARTUP_TX_POWER_DBM
    int "Startup Zigbee transmit power (dBm)"
    default -10
    range -24 20
    help
        Conservative startup transmit power. Do not restore a higher power at
        boot solely because it was used in a previous weak-link session.

config BATT_REPORT_LOCAL_ATTEMPTS
    int "Local report submission attempts"
    default 3
    range 1 5
    help
        Retry only when the local APS request is rejected. Once a frame has
        been accepted but later fails, wait for the next sample period.

config BATT_REPORT_GAP_MS
    int "Gap between separate ZCL reports (milliseconds)"
    default 200
    range 0 2000
    help
        Short spacing between temperature, humidity and illuminance reports.

endmenu
```

## firmware/node_battery_sensor/sdkconfig.defaults
```kconfig
# Zigbee end device
CONFIG_ZB_ENABLED=y
CONFIG_ZB_ZED=y

# Light-sleep / SED
CONFIG_PM_ENABLE=y
CONFIG_FREERTOS_USE_TICKLESS_IDLE=y
CONFIG_PM_POWER_DOWN_PERIPHERAL_IN_LIGHT_SLEEP=y
CONFIG_IEEE802154_SLEEP_ENABLE=y
CONFIG_ESP_SLEEP_POWER_DOWN_FLASH=y
CONFIG_FREERTOS_HZ=1000

# 4 MB flash and custom partition table
CONFIG_ESPTOOLPY_FLASHSIZE_4MB=y
CONFIG_ESPTOOLPY_FLASHSIZE="4MB"
CONFIG_PARTITION_TABLE_CUSTOM=y
CONFIG_PARTITION_TABLE_CUSTOM_FILENAME="partitions.csv"

CONFIG_ESP_CONSOLE_USB_SERIAL_JTAG=y
CONFIG_LOG_DEFAULT_LEVEL_INFO=y
```
